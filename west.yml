## west.yml
```yaml
# Copyright (c) 2023 CATIE
# SPDX-License-Identifier: Apache-2.0

manifest:
  remotes:
    - name: catie-6tron
      url-base: https://github.com/catie-aq

  defaults:
    remote: catie-6tron

  projects:
    - name: 6tron_connector
      repo-path: zephyr_6tron-connector
      revision: 7796488103213b53db64830809c55ba2e34016e1
      path: 6tron/6tron_connector

    # ================== Zest_Core Boards ==================
    - name: zest_core_fmlr-72
      repo-path: zephyr_zest-core-fmlr-72
      revision: 319b6bee38d7014631a8a42484a1230535444006
      path: 6tron/boards/zest_core_fmlr-72
    - name: zest_core_nrf52832
      repo-path: zephyr_zest-core-nrf52832
      revision: fd1287515dd49a51faed8a3a21531702380db86a
      path: 6tron/boards/zest_core_nrf52832
    - name: zest_core_nrf5340
      repo-path: zephyr_zest-core-nrf5340
      revision: 9fc277706d380349112906d85c64159391af9253
      path: 6tron/boards/zest_core_nrf5340
    - name: zest_core_stm32g474ve
      repo-path: zephyr_zest-core-stm32g474ve
      revision: 99f6c408ef088f247588566428d6057fe0f77879
      path: 6tron/boards/zest_core_stm32g474ve
    - name: zest_core_stm32h753zi
      repo-path: zephyr_zest-core-stm32h753zi
      revision: d5329e3408340a01e900b58a9b26331e7bccb92d
      path: 6tron/boards/zest_core_stm32h753zi
    - name: zest_core_stm32l4a6rg
      repo-path: zephyr_zest-core-stm32l4a6rg
      revision: 0e5ffad8b42cb80995e74e7e9b2c89209e738c43
      path: 6tron/boards/zest_core_stm32l4a6rg
    - name: zest_core_stm32l562ve
      repo-path: zephyr_zest-core-stm32l562ve
      revision: dad092d1e6483d321366faeef114d75c1b0f0b67
      path: 6tron/boards/zest_core_stm32l562ve

    # ================= Integrated Devices =================
    - name: z_iaq
      repo-path: zephyr_z-iaq
      revision: 972051c8dafbf4ed1027eb16ff2c086bfa6a605b
      path: 6tron/boards/z_iaq
    - name: z_motion
      repo-path: zephyr_z-motion
      revision: a90f1319ac9c84bf8eec49dcbd0c366cb165be9e
      path: 6tron/boards/z_motion

    # ==================== Zest Shields =====================
    - name: zest_adapter_click
      repo-path: zephyr_zest-adapter-click
      revision: b2f9751dcbd1a2e92e08cb6cdfbda1d351d9a64b
      path: 6tron/shields/zest_adapter_click
    - name: zest_battery_lipo
      repo-path: zephyr_zest-battery-lipo
      revision: 4a4a05d6c5188bf0945a3cfca9cc434690aca421
      path: 6tron/shields/zest_battery_lipo
    - name: zest_interface_ethernet
      repo-path: zephyr_zest-interface-ethernet
      revision: 082bbdce1206ad1439f4448d5ae8ce4d1d475049
      path: 6tron/shields/zest_interface_ethernet
    - name: zest_interface_rs232
      repo-path: zephyr_zest-interface-rs232
      revision: db8c42580e114d865365780a3384bed188ee72cb
      path: 6tron/shields/zest_interface_rs232
    - name: zest_interface_rs485
      repo-path: zephyr_zest-interface-rs485
      revision: 0759bdf69eb7a7f2ffb0d4ae5180003de2258a2d
      path: 6tron/shields/zest_interface_rs485
    - name: zest_radio_gnss
      repo-path: zephyr_zest-radio-gnss
      revision: f87f8c6f42d3564339453eca2d000c8ed18ffda5
      path: 6tron/shields/zest_radio_gnss
    - name: zest_radio_lora868
      repo-path: zephyr_zest-radio-lora868
      revision: 0961c330c5e5eaaf15d8a5d5206549363e13a8d0
      path: 6tron/shields/zest_radio_lora868
    - name: zest_rtc_rv-8803-c7
      repo-path: zephyr_zest-rtc-rv-8803-c7
      revision: 64838aa7cc4e8a7317517448447a22b8304b8e39
      path: 6tron/zest_rtc_rv-8803-c7
    - name: zest_sensor_imu
      repo-path: zephyr_zest-sensor-imu
      revision: 55cce937a307c3b67bf9eb6c93005d96c465f91d
      path: 6tron/shields/zest_sensor_imu
    - name: zest_sensor_p-t-rh
      repo-path: zephyr_zest-sensor-p-t-rh
      revision: 7cd482f65c0ed1101eb6fc33a702c2ebbfc6ec0b
      path: 6tron/shields/zest_sensor_p-t-rh
    - name: zest_storage_microsd
      repo-path: zephyr_zest-storage-microsd
      revision: 959c28f3058d8a821a54a21aa5d77db62fa725c8
      path: 6tron/shields/zest_storage_microsd

    # ====================== Drivers =======================
    - name: ams_as621x
      repo-path: zephyr_ams-as621x
      revision: 096219be378848cb9a319b27095b5db6ce2f5fac
      path: 6tron/drivers/ams_as621x
    - name: bosch_bno055
      repo-path: zephyr_bosch-bno055
      revision: bbf91f02757d5155e99af76259dd89a0beada7ac
      path: 6tron/drivers/bosch_bno055
    - name: honeywell_hpma115
      repo-path: zephyr_honeywell-hpma115
      revision: 3ff05a557efafe53d99abea3f827ec33638ed16d
      path: 6tron/drivers/honeywell_hpma115
    - name: maxim_max17201
      repo-path: zephyr_maxim-max17201
      revision: 67941660860215143ae021ad04c5c94de44b1e7e
      path: 6tron/drivers/maxim_max17201
    - name: microchip_mcp3425
      repo-path: zephyr_microchip-mcp3425
      revision: 247b3af96bea84b3a2edf496a8ffcb4e04d84b19
      path: 6tron/drivers/microchip_mcp3425
    - name: microcrystal_rv8803
      repo-path: zephyr_microcrystal-rv8803
      revision: fac72b2a27d5cca38fb91cb15f03f4f6bc60012c
      path: 6tron/drivers/microcrystal_rv8803
    - name: omron_2smpb-02e
      repo-path: zephyr_omron-2smpb-02e
      revision: 28f602257de6b78a6f82fc826a4ba5c8aa9fcdc7
      path: 6tron/drivers/omron_2smpb-02e
    - name: quectel_l86
      repo-path: zephyr_quectel-l86
      revision: 2744d16730f001417aa909f8420182a44069ff74
      path: 6tron/drivers/quectel_l86
    - name: sensirion_scd4x
      repo-path: zephyr_sensirion-scd4x
      revision: 3688d44c051071e721a08f4ce4ea8caa778eb62b
      path: 6tron/drivers/sensirion_scd4x
    - name: te-connectivity_htu21d
      repo-path: zephyr_te-connectivity-htu21d
      revision: cb10ac462907403ba2fcbc6289c80ecf59e1d302
      path: 6tron/drivers/te-connectivity_htu21d
```
